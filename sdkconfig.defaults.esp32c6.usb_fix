## sdkconfig.defaults.esp32c6.usb_fix
```kconfig
CONFIG_IDF_TARGET="esp32c6"

# Enable OpenThread
CONFIG_OPENTHREAD_ENABLED=y
CONFIG_OPENTHREAD_SRP_CLIENT=y
CONFIG_OPENTHREAD_LOG_LEVEL_DYNAMIC=n
CONFIG_OPENTHREAD_LOG_LEVEL_NOTE=y
CONFIG_OPENTHREAD_CLI=n

# Disable lwip ipv6 autoconfig
CONFIG_LWIP_IPV6_AUTOCONFIG=n

# LwIP config for OpenThread
CONFIG_LWIP_IPV6_NUM_ADDRESSES=8
CONFIG_LWIP_MULTICAST_PING=y

# MDNS platform
CONFIG_USE_MINIMAL_MDNS=n

# Disable STA for ESP32C6
CONFIG_ENABLE_WIFI_STATION=n

# Disable chip shell
CONFIG_ENABLE_CHIP_SHELL=n

# BLE Sleep
CONFIG_BT_LE_SLEEP_ENABLE=y
CONFIG_BT_LE_LP_CLK_SRC_MAIN_XTAL=y

# Disable external 32K crystal
CONFIG_RTC_CLK_SRC_EXT_CRYS=n

# Modified power management to preserve USB connection
CONFIG_PM_ENABLE=y
CONFIG_PM_DFS_INIT_AUTO=y
# DISABLED: This was causing USB disconnection
CONFIG_PM_POWER_DOWN_PERIPHERAL_IN_LIGHT_SLEEP=n
CONFIG_ESP_SLEEP_POWER_DOWN_FLASH=n
# DISABLED: This was affecting USB stability
CONFIG_ESP_PHY_MAC_BB_PD=n

# FreeRTOS config - modified to preserve USB
CONFIG_FREERTOS_HZ=1000
# DISABLED: Tickless idle can cause USB issues during development
CONFIG_FREERTOS_USE_TICKLESS_IDLE=n

# Enable IEEE 802.15.4 sleep
CONFIG_IEEE802154_SLEEP_ENABLE=y
CONFIG_IEEE802154_RX_BUFFER_SIZE=20

# FreeRTOS config for light sleep
CONFIG_LWIP_ND6=n
CONFIG_LWIP_IPV4=n
CONFIG_DISABLE_IPV4=y

# Disable hardware acceleration
CONFIG_MBEDTLS_HARDWARE_AES=n
CONFIG_MBEDTLS_HARDWARE_MPI=n
CONFIG_MBEDTLS_HARDWARE_SHA=n
CONFIG_MBEDTLS_HARDWARE_ECC=n
CONFIG_MBEDTLS_HARDWARE_ECDSA_VERIFY=n
CONFIG_MBEDTLS_SSL_PROTO_DTLS=y

# Use OpenThread MTD
CONFIG_OPENTHREAD_MTD=y

# ICD configurations - modified for USB stability
CONFIG_ENABLE_ICD_SERVER=y
CONFIG_ICD_FAST_POLL_INTERVAL_MS=500
CONFIG_ICD_IDLE_MODE_INTERVAL_SEC=60
CONFIG_ICD_ACTIVE_MODE_INTERVAL_MS=1000
CONFIG_ICD_ACTIVE_MODE_THRESHOLD_MS=1000
CONFIG_ENABLE_ICD_LIT=y

# USB Serial/JTAG Console configuration to prevent disconnection
CONFIG_ESP_CONSOLE_USB_SERIAL_JTAG=y
CONFIG_ESP_CONSOLE_SECONDARY_NONE=y
CONFIG_ESP_CONSOLE_USB_SERIAL_JTAG_ENABLED=y

# Prevent USB from being powered down
CONFIG_ESP_SLEEP_POWER_DOWN_CPU=n
CONFIG_ESP_SLEEP_RTC_FAST_MEM_KEEP_ISO=y
CONFIG_ESP_SLEEP_RTC_SLOW_MEM_KEEP_ISO=y

# Disable automatic light sleep to prevent USB issues during development
CONFIG_PM_SLP_DISABLE_GPIO=y
```
